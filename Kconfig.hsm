## Kconfig.hsm
```kconfig
menu "Home Smart Mesh"

rsource "samples/Kconfig"
rsource "drivers/Kconfig"
rsource "subsys/Kconfig"

endmenu
```

## drivers/Kconfig
```kconfig
menu "Device Drivers"

rsource "sensor/Kconfig"

rsource "battery/Kconfig"

endmenu
```

## drivers/battery/Kconfig
```kconfig
config BATTERY
	bool "BATTERY ADC VDD"
	depends on ADC
	help
	  Enable driver for measuring Battery through ADC VDD Channel.
```

## drivers/sensor/Kconfig
```kconfig
menuconfig SENSOR
	bool "Sensor Drivers"
	help
		Include sensor drivers in config

if SENSOR

rsource "veml6030/Kconfig"
rsource "ms8607/Kconfig"

endif # SENSOR
```

## drivers/sensor/ms8607/Kconfig
```kconfig
# MS8607 temperature, humidity and pressure configuration options

config MS8607
	bool "MS8607 temperature, humidity and pressure Sensor"
	depends on I2C
	help
	  Enable driver for MS8607 temperature, humidity and pressure sensors.
```

## dts/bindings/sensor/teconnectivity,ms8607.yaml
```yaml
# Copyright (c) 2019, Linaro Limited
# SPDX-License-Identifier: Apache-2.0

description: |
    Temperature humidity and pressure Sensor With I2C Interface.
    See datasheet at https://www.te.com/commerce/DocumentDelivery/DDEController?Action=showdoc&DocId=Data+Sheet%7FMS8607-02BA01%7FB3%7Fpdf%7FEnglish%7FENG_DS_MS8607-02BA01_B3.pdf%7FCAT-BLPS0018

compatible: "teconnectivity,ms8607"

include: i2c-device.yaml
```

## dts/bindings/sensor/vishay,veml6030.yaml
```yaml
# Copyright (c) 2019, Linaro Limited
# SPDX-License-Identifier: Apache-2.0

description: |
    High Accuracy Ambient Light Sensor With I2C Interface.
    See datasheet at https://www.vishay.com/docs/84366/veml6030.pdf

compatible: "vishay,veml6030"

include: i2c-device.yaml

properties:
    int-gpios:
      type: phandle-array
      required: false
```

## samples/Kconfig
```kconfig
config HSM_SAMPLES_DEFAULTS
	bool "Enable HSM sample default settings"
	default n
	imply LOG
	imply LOG_MINIMAL
	imply ASSERT
	imply ASSERT_NO_COND_INFO
	imply ASSERT_NO_MSG_INFO
	imply HW_STACK_PROTECTION if ARCH_HAS_STACK_PROTECTION
	help
	  Use the default configuration for HSM samples.

if LOG

# LOG_DEFAULT_LEVEL is declared in Zephyr,
# we declare it here for a second time, to set a different default.
# Omit the `prompt` to prevent it from appearing twice in two diffent places.

config LOG_DEFAULT_LEVEL
	default 1 if HSM_SAMPLES_DEFAULTS

endif # LOG
```

## subsys/Kconfig
```kconfig
#
# Copyright (c) 2018 - 2020 Nordic Semiconductor
#
# SPDX-License-Identifier: LicenseRef-Nordic-5-Clause
#

rsource "esb/Kconfig"
rsource "simplemesh/Kconfig"
rsource "app_ot/Kconfig"
```

## subsys/app_battery/Kconfig
```kconfig
menuconfig APP_BATTERY
	bool "Application battery sensor API"
	default n
	depends on ADC
	help
	  Enable Application battery sensor API.
```

## subsys/app_flash/Kconfig
```kconfig
menuconfig APP_FLASH
	bool "Application read write flash"
	default n
	depends on FLASH
	help
	  Enable Application read write flash.
```

## subsys/app_led/Kconfig
```kconfig
menuconfig APP_LED
	bool "Application LED API"
	default n
	depends on PWM
	help
	  Enable Application RGB LED API for state, color, blink.
```

## subsys/app_ot/Kconfig
```kconfig
menuconfig APP_OT
	bool "Application Open Thread Management"
	default n
	depends on NET_L2_OPENTHREAD
	help
	  Enable Application Open Thread API for printing joiner info, button reset and factory reset.
```

## subsys/simplemesh/Kconfig
```kconfig
menuconfig SIMPLEMESH
	bool "Simple Mesh Protocol"
	default n
	depends on ESB
	help
	  Enable SIMPLEMESH functionality.

if SIMPLEMESH

config SM_LISTENER
	bool "device RX listen when idle"
	default y
	help
	  If the device is listening when not transmitting

config SM_COORDINATOR
	bool "assign short ids"
	default y
	help
	  If the device assigns short ids

config SM_CHANNEL
	int "RF Channel"
	default 20
	help
	  The RF Channel (2400 + SM_CHANNEL) MHz

	config SM_GPIO_DEBUG
		bool "simple mesh gpio debug"
		default n
		help
		Enable gpio debug for simple mesh

	if SM_GPIO_DEBUG
		config SM_PIN_APP
			int "gpio debug for simple mesh 2.4GHz radio"
			default 13
			help
			The default used pin is the DWM1001-Dev kit [nRF] P0.13 => M_PIN17 => J7 pin 8
	endif # SM_GPIO_DEBUG
endif # SIMPLEMESH
```

## west.yml
```yaml
manifest:
  version: "0.12"
  remotes:
    # Home Smart Mesh GitHub organization.
    - name: hsm
      url-base: https://github.com/HomeSmartMesh
    - name: ncs
      url-base: https://github.com/nrfconnect
    - name: zephyrproject
      url-base: https://github.com/zephyrproject-rtos

  defaults:
    remote: hsm

  projects:
    - name: nrf
      remote: ncs
      repo-path: sdk-nrf
      revision: v2.3.0
      path: nrf
    - name: nrfxlib
      remote: ncs
      repo-path: sdk-nrfxlib
      path: nrfxlib
      revision: v2.3.0
    - name: zephyr
      remote: ncs
      repo-path: sdk-zephyr
      revision: v3.2.99-ncs2
      import:
        name-allowlist:
          - cmsis
          - edtt
          - fatfs
          - hal_nordic
          - libmetal
          - littlefs
          - lvgl
          - mipi-sys-t
          - net-tools
          - nrf_hw_models
          - open-amp
          - openthread
          - segger
          - tinycrypt
    - name: openthread
      remote: ncs
      repo-path: sdk-openthread
      path: modules/lib/openthread
      revision: 2060039bbfec52ac00f22a7cc3213c2ab1df138e
    - name: mcuboot
      remote: ncs
      repo-path: sdk-mcuboot
      revision: v1.9.99-ncs4
      path: bootloader/mcuboot
    - name: mbedtls
      remote: ncs
      path: modules/crypto/mbedtls
      repo-path: sdk-mbedtls
      revision: v3.1.0-ncs3

  self:
    path: hsm
    west-commands: nrf/scripts/west-commands.yml
```
