## CMakeLists.txt
```
set(BOARD_ROOT ${CMAKE_CURRENT_SOURCE_DIR}/../..)

cmake_minimum_required(VERSION 3.13.1)
find_package(Zephyr REQUIRED HINTS $ENV{ZEPHYR_BASE})
project(adc_battery)

target_sources(app PRIVATE 
    src/main.c
    src/battery.c)
```

## sample.yaml
```
sample:
  name: Battery Sample
```

## prj.conf
```kconfig
CONFIG_GPIO=y
CONFIG_SERIAL=n

CONFIG_ADC=y
CONFIG_BATTERY=y

# Logging
CONFIG_LOG=y
CONFIG_LOG_BACKEND_RTT=y
CONFIG_LOG_BACKEND_UART=n
CONFIG_BOOT_BANNER=y
CONFIG_USE_SEGGER_RTT=y
CONFIG_CONSOLE=y
CONFIG_UART_CONSOLE=n
CONFIG_RTT_CONSOLE=y

CONFIG_NEWLIB_LIBC=y
CONFIG_NEWLIB_LIBC_FLOAT_PRINTF=y
```

## src/main.c
```c
#include <zephyr/kernel.h>
#include <zephyr/logging/log.h>
#include <stdio.h>

#include <battery.h>

LOG_MODULE_REGISTER(main, LOG_LEVEL_INF);

void main(void)
{
	LOG_INF("Battery Voltage Measure ADC VDD channel");

	battery_init();

	while (1) {
		battery_start();
		k_sleep(K_MSEC(1));//max acquisition time
		int32_t voltage = battery_get_mv();
		LOG_INF("battery> Voltage = %d mV",voltage);
		k_sleep(K_MSEC(4999));
	}
}
```

## src/battery.c
```c
#include <zephyr.h>
#include <device.h>
#include <devicetree.h>
#include <logging/log.h>
#include <drivers/adc.h>

LOG_MODULE_REGISTER(battery, LOG_LEVEL_INF);

#define ADC_CHANNEL				0
#define ADC_RESOLUTION			12
#define ADC_GAIN				ADC_GAIN_1_6
#define ADC_REFERENCE			ADC_REF_INTERNAL
#define ADC_ACQUISITION_TIME	ADC_ACQ_TIME(ADC_ACQ_TIME_MICROSECONDS,40)

const struct device *dev_adc;
static int16_t sample;
int32_t adc_vref;
struct adc_channel_cfg channel_cfg = {
	.gain = ADC_GAIN,
	.reference = ADC_REFERENCE,
	.acquisition_time = ADC_ACQUISITION_TIME,
	.channel_id = ADC_CHANNEL,
	#ifdef CONFIG_ADC_CONFIGURABLE_INPUTS
	.differential = 0,
	.input_positive = SAADC_CH_PSELN_PSELN_VDD
	#else
	.differential = 0
	#endif
};

struct adc_sequence sequence = {
	.channels    = BIT(ADC_CHANNEL),
	.buffer      = &sample,
	/* buffer size in bytes, not number of samples */
	.buffer_size = sizeof(sample),
	.resolution  = ADC_RESOLUTION,
};

void battery_init()
{
	dev_adc = device_get_binding(DT_LABEL(DT_NODELABEL(adc)));
	if (!device_is_ready(dev_adc)) {
		LOG_ERR("ADC device not found\n");
		return;
	}

	adc_channel_setup(dev_adc, &channel_cfg);
	adc_vref = adc_ref_internal(dev_adc);

	LOG_INF("battery_init() vref = %d",adc_vref);
}

void battery_start()
{
	int err = adc_read(dev_adc, &sequence);
	if (err != 0) {
		LOG_ERR("ADC reading failed with error %d.\n", err);
		return;
	}else{
		LOG_INF("battery_start> adc_read()");
	}
}

int32_t battery_get_mv()
{
	int32_t raw_value = sample;
	LOG_INF("battery_get_mv() raw = %d",raw_value);
	int32_t mv_value = raw_value;
	adc_raw_to_millivolts(adc_vref, ADC_GAIN,ADC_RESOLUTION, &mv_value);
	return mv_value;
}
```

## src/battery.h
```c
#ifndef __BATTERY_H__
#define __BATTERY_H__


#include <stdint.h>

void battery_init();

void battery_start();

uint16_t battery_get_mv();

#endif /*__BATTERY_H__*/
```
