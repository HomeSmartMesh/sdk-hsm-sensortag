## CMakeLists.txt
```
set(BOARD_ROOT ${CMAKE_CURRENT_SOURCE_DIR}/../..)

cmake_minimum_required(VERSION 3.13.1)
find_package(Zephyr REQUIRED HINTS $ENV{ZEPHYR_BASE})
project(sesnors_broadcast)

target_sources(app PRIVATE src/main.c src/udp_client.c)
```

## sample.yaml
```
sample:
  name: Power Management Sample
```

## prj.conf
```kconfig
CONFIG_I2C=y
CONFIG_SENSOR=y
CONFIG_VEML6030=y
CONFIG_MS8607=y

CONFIG_ADC=y
CONFIG_BATTERY=y
CONFIG_APP_OT=y
CONFIG_APP_FLASH=y
CONFIG_APP_LED=y


CONFIG_GPIO=y
CONFIG_PINCTRL=y



CONFIG_OPENTHREAD_NORDIC_LIBRARY_MASTER=y
CONFIG_NETWORKING=y
CONFIG_NET_L2_OPENTHREAD=y
CONFIG_NET_IPV6_NBR_CACHE=n
CONFIG_NET_IPV6_MLD=n
CONFIG_NET_SOCKETS=y
CONFIG_NET_SOCKETS_POLL_MAX=5
CONFIG_NET_SOCKETS_POSIX_NAMES=y
CONFIG_NET_CONNECTION_MANAGER=n
CONFIG_NET_IPV4=n
CONFIG_NET_IPV6=y
CONFIG_OPENTHREAD_FTD=n
CONFIG_OPENTHREAD_NORDIC_LIBRARY_MTD=y
CONFIG_OPENTHREAD_MTD=y
CONFIG_OPENTHREAD_MTD_SED=y
CONFIG_OPENTHREAD_MANUAL_START=n
CONFIG_MBEDTLS_SHA1_C=n
CONFIG_FPU=y
CONFIG_OPENTHREAD_JOINER=y
CONFIG_OPENTHREAD_JOINER_AUTOSTART=y
CONFIG_OPENTHREAD_JOINER_PSKD="ABCDE2"
CONFIG_OPENTHREAD_SLAAC=y

CONFIG_NEWLIB_LIBC=y
CONFIG_NEWLIB_LIBC_FLOAT_PRINTF=y

#prevents Stack overflow on k_work_
CONFIG_SYSTEM_WORKQUEUE_STACK_SIZE=4096
CONFIG_MAIN_STACK_SIZE=8192

#Low power config
CONFIG_PM=y
CONFIG_PM_DEVICE=y
CONFIG_SERIAL=n
CONFIG_LOG=n
CONFIG_CONSOLE=n
CONFIG_UART_CONSOLE=n
CONFIG_RTT_CONSOLE=n
CONFIG_USE_SEGGER_RTT=n
CONFIG_PRINTK=n
CONFIG_NETWORKING=y
CONFIG_OPENTHREAD_SHELL=n
CONFIG_OPENTHREAD_POLL_PERIOD=600000
########################################
#CONFIG_INIT_STACKS=y
#CONFIG_NET_UDP=y
#CONFIG_NET_TCP=n
#CONFIG_NET_CONNECTION_MANAGER=y
#CONFIG_NET_PKT_RX_COUNT=1
#CONFIG_NET_PKT_TX_COUNT=4
#CONFIG_NET_BUF_RX_COUNT=2
#CONFIG_NET_BUF_TX_COUNT=8
#CONFIG_NET_CONTEXT_NET_PKT_POOL=y
#CONFIG_NET_IF_UNICAST_IPV6_ADDR_COUNT=3
#CONFIG_NET_IF_MCAST_IPV6_ADDR_COUNT=4
#CONFIG_NET_MAX_CONTEXTS=2
```

## overlay-log.conf
```kconfig
# Logging
CONFIG_LOG=y
CONFIG_LOG_MODE_DEFERRED=y
CONFIG_LOG_MAX_LEVEL=3

CONFIG_LOG_BACKEND_RTT=y
CONFIG_LOG_BACKEND_UART=n
CONFIG_BOOT_BANNER=y
CONFIG_USE_SEGGER_RTT=y

#console
CONFIG_CONSOLE=y
CONFIG_UART_CONSOLE=n
CONFIG_RTT_CONSOLE=y

# shell
CONFIG_SHELL=n
CONFIG_SHELL_BACKEND_RTT=n
CONFIG_SHELL_BACKEND_SERIAL=n
CONFIG_NET_SHELL=n
CONFIG_OPENTHREAD_SHELL=n

CONFIG_NET_STATISTICS=y
CONFIG_PRINTK=y

CONFIG_NET_LOG=y
CONFIG_NET_CONFIG_LOG_LEVEL_INF=y
CONFIG_OPENTHREAD_DEBUG=y
CONFIG_OPENTHREAD_LOG_LEVEL_INFO=y
```

## overlay-piodebug.conf
```kconfig
#For GPIO debug
CONFIG_GPIO=y
```

## prj-fixed.conf
```kconfig
# Peripherals
CONFIG_ADC=y
CONFIG_BATTERY=y

CONFIG_I2C=y
CONFIG_SENSOR=y
CONFIG_VEML6030=y
CONFIG_MS8607=y

CONFIG_GPIO=y

# Power optimization
CONFIG_PM=y
CONFIG_PM_DEVICE=y
CONFIG_SERIAL=n
CONFIG_LOG=n
CONFIG_CONSOLE=n
CONFIG_UART_CONSOLE=n
CONFIG_RTT_CONSOLE=n
CONFIG_USE_SEGGER_RTT=n
CONFIG_PRINTK=n

# message generation
CONFIG_NEWLIB_LIBC=y
CONFIG_NEWLIB_LIBC_FLOAT_PRINTF=y

# Network
CONFIG_NETWORKING=y
CONFIG_NET_L2_OPENTHREAD=y

# Minimal Thread Device & Sleepy End Device
CONFIG_OPENTHREAD_MTD=n
CONFIG_OPENTHREAD_MTD_SED=n
CONFIG_OPENTHREAD_SHELL=n
CONFIG_OPENTHREAD_FTD=y
#CONFIG_OPENTHREAD_POLL_PERIOD=600000
CONFIG_OPENTHREAD_MANUAL_START=n

CONFIG_OPENTHREAD_CHANNEL=24
CONFIG_OPENTHREAD_PANID=4660
CONFIG_OPENTHREAD_NETWORK_NAME="ThreadMatter"
CONFIG_OPENTHREAD_XPANID="11:11:11:11:22:22:22:22"
CONFIG_OPENTHREAD_NETWORKKEY="00:11:22:33:44:55:66:77:88:99:aa:bb:cc:dd:ee:ff"


#CONFIG_NET_CONFIG_MY_IPV6_ADDR="fdde:ad00:beef::1"
#CONFIG_NET_CONFIG_PEER_IPV6_ADDR="ff02::1"
#CONFIG_PEER_PORT=4141

# Disable certain parts of Zephyr IPv6 stack
CONFIG_NET_IPV6_NBR_CACHE=n
CONFIG_NET_IPV6_MLD=n

# Kernel options
CONFIG_MAIN_STACK_SIZE=4096
CONFIG_INIT_STACKS=y

# Generic networking options
CONFIG_NET_UDP=y
CONFIG_NET_TCP=n
CONFIG_NET_SOCKETS=y
CONFIG_NET_SOCKETS_POSIX_NAMES=y
CONFIG_NET_SOCKETS_POLL_MAX=4
CONFIG_NET_CONNECTION_MANAGER=y

# Network buffers
CONFIG_NET_PKT_RX_COUNT=1
CONFIG_NET_PKT_TX_COUNT=4
CONFIG_NET_BUF_RX_COUNT=2
CONFIG_NET_BUF_TX_COUNT=8
CONFIG_NET_CONTEXT_NET_PKT_POOL=y

# IP address options
CONFIG_NET_IF_UNICAST_IPV6_ADDR_COUNT=3
CONFIG_NET_IF_MCAST_IPV6_ADDR_COUNT=4
CONFIG_NET_MAX_CONTEXTS=2
```

## src/main.c
```c
#include <zephyr/kernel.h>
#include <zephyr/logging/log.h>
#include <zephyr/net/socket.h>
#include <zephyr/net/net_if.h>
#include <stdio.h>
#include <zephyr/drivers/gpio.h>
#include <zephyr/drivers/sensor.h>
#include <sensor/veml6030.h>
#include <sensor/ms8607.h>
#include <zephyr/sys/printk.h>
#include <zephyr/sys/reboot.h>

#include <zephyr/net/openthread.h>
#include <openthread/thread.h>

#include "battery.h"
#include "udp_client.h"
#include "app_ot.h"
#include "flash_settings_storage.h"


LOG_MODULE_REGISTER(main, LOG_LEVEL_DBG);
//#define CONFIG_GPIO_DEBUG
#ifdef CONFIG_GPIO_DEBUG
	#include <zephyr/drivers/gpio.h>
	#define DEBUG_PIN_APP 	 2
	#define DEBUG_PIN_LOOP	29

	#define APP_SET 	gpio_pin_set(gpio_dev, DEBUG_PIN_APP, 1)
	#define APP_CLEAR 	gpio_pin_set(gpio_dev, DEBUG_PIN_APP, 0)
	#define LOOP_SET 	gpio_pin_set(gpio_dev, DEBUG_PIN_LOOP, 1)
	#define LOOP_CLEAR 	gpio_pin_set(gpio_dev, DEBUG_PIN_LOOP, 0)

	const struct device *gpio_dev;
	void gpio_pin_init()
	{
		gpio_dev = device_get_binding(DT_LABEL(DT_NODELABEL(gpio0)));
		gpio_pin_configure(gpio_dev, DEBUG_PIN_APP, GPIO_OUTPUT_ACTIVE);
		gpio_pin_configure(gpio_dev, DEBUG_PIN_LOOP, GPIO_OUTPUT_ACTIVE);
	}
#else
	#define APP_SET
	#define APP_CLEAR
	#define LOOP_SET
	#define LOOP_CLEAR
	#define gpio_pin_init()
#endif

#define SLEEP_DETACHED_SEC 40U
#define SLEEP_CYCLE_SEC 30U

#define SLEEP_QUICK_REBOOT_SEC 3U

char uid_text[20];

const struct device *light_dev = DEVICE_DT_GET_ONE(vishay_veml6030);


void report_sensors(int count,bool send){
	APP_SET;
	battery_start();
	k_sleep(K_MSEC(10));
	int32_t voltage_mv = battery_get_mv();
	float voltage = voltage_mv;
	voltage /= 1000;
	float light = veml6030_auto_measure(light_dev);
	float t, p, h;
	enum ms8607_status status = ms8607_read_temperature_pressure_humidity(&t,&p,&h);
	if(status != ms8607_status_ok){
		LOG_ERR("ms8607> status = %d",status);
	}
	APP_CLEAR;

	char message[250];
	int size = sprintf(message,"thread_tags/%s{\"alive\":%d,\"voltage\":%.3f,\"light\":%0.3f,\"temperature\":%.2f,\"humidity\":%.2f,\"pressure\":%.2f}",
								uid_text,count, voltage, light, t, h, p);
	if(send){
		APP_SET;
		send_udp(message, size);
		APP_CLEAR;
	}
	LOG_INF("%s",message);
}

void main(void)
{
	//   ---    handle quick reboot   ---
	uint32_t quick_rebout_count;
	fss_read_word(&quick_rebout_count);
	LOG_INF("Quick reboot count:%u",quick_rebout_count);
	if(quick_rebout_count == 2){
		LOG_INF("Quick reboot count limit reached - reset counter");
		quick_rebout_count = 0;
		fss_write_word(&quick_rebout_count);
		LOG_INF("Performing factory reset");
		k_sleep(K_MSEC(1000));
		quick_reboot_factoryreset();
	}
	quick_rebout_count++;
	fss_write_word(&quick_rebout_count);

	gpio_pin_init();
	APP_CLEAR;
	LOOP_CLEAR;
	k_sleep(K_MSEC(10));

	LOG_INF("Hello Sensors Broadcast");

	battery_init();
	app_ot_init();//logs joiner info and initializes reset buttons
	//getting the ms8607 is not needed due to the hardcoding of i2c adresses, multi instance is not possible
	//const struct device *env_dev = device_get_binding(DT_LABEL(DT_INST(0, teconnectivity_ms8607)));
	if(ms8607_is_connected()){
		LOG_INF("ms8607> connected");
	}else{
		LOG_ERR("ms8607> not connected");
	}

	long unsigned int id0 = NRF_FICR->DEVICEID[0];//just for type casting and readable printing
	long unsigned int id1 = NRF_FICR->DEVICEID[1];
	sprintf(uid_text,"%04lX%04lX",id0,id1);
	LOG_INF("Device ID:%s",uid_text);

	//long unsigned int abs_reboot = NRF_UICR->CUSTOMER[0];
	//abs_reboot++;
	//NRF_UICR->CUSTOMER[0] = abs_reboot;
	//LOG_INF("Abs reboot count (CUSTOMER[0]):%08lX",abs_reboot);

	k_sleep(K_MSEC(SLEEP_QUICK_REBOOT_SEC*1000));
	//after SLEEP_QUICK_REBOOT_SEC, disable quick reboot
	quick_rebout_count = 0;
	fss_write_word(&quick_rebout_count);

	int count = 0;
	while (1) {
		LOOP_SET;
		LOG_INF("starting loop (%d)",count);

		otDeviceRole role = ot_app_role();
		bool send = (role >= OT_DEVICE_ROLE_CHILD);
		report_sensors(count,send);

		if(role <= OT_DEVICE_ROLE_DETACHED){
			LOG_INF("role: %s; sleeping %d sec cout = %d",
				(role == OT_DEVICE_ROLE_DISABLED)?"Disabled":"Detached",
				SLEEP_DETACHED_SEC,count);
			k_sleep(K_MSEC(SLEEP_DETACHED_SEC*1000));
			role = ot_app_role();
			if(role <= OT_DEVICE_ROLE_DISABLED){
				sys_reboot(SYS_REBOOT_WARM);
			}
		}else{
			LOG_INF("sleeping %d sec count = %d",SLEEP_CYCLE_SEC,count);
			k_sleep(K_MSEC(SLEEP_CYCLE_SEC*1000));
		}
		count++;
		LOOP_CLEAR;
	}
}
```

## src/udp_client.c
```c
//zephyr\samples\net\sockets\echo_client\src\udp.c
#include <zephyr/kernel.h>
#include <zephyr/logging/log.h>
#include <zephyr/net/socket.h>
#include <stdio.h>

LOG_MODULE_REGISTER(udp_client, LOG_LEVEL_INF);

bool udp_started = false;

#define CONFIG_PEER_PORT 4141
#if !defined(CONFIG_NET_CONFIG_PEER_IPV6_ADDR)
#define CONFIG_NET_CONFIG_PEER_IPV6_ADDR "ff03::1"
#endif
#define INVALID_SOCK (-1)

int sock = INVALID_SOCK;

int start_udp(void)
{
	int ret = 0;
	struct sockaddr_in6 addr6;

	LOG_INF("CONFIG_NET_IPV6");
	addr6.sin6_family = AF_INET6;
	addr6.sin6_port = htons(CONFIG_PEER_PORT);
	inet_pton(AF_INET6, CONFIG_NET_CONFIG_PEER_IPV6_ADDR,&addr6.sin6_addr);

	sock = socket(addr6.sin6_family, SOCK_DGRAM, IPPROTO_UDP);
	if (sock < 0) {
		LOG_ERR("Failed to create UDP socket : %d", errno);
		return -errno;
	}

	/* Call connect so we can use send and recv. */
	ret = connect(sock, (struct sockaddr *)&addr6, sizeof(addr6));
	if (ret < 0) {
		LOG_ERR("Cannot connect to UDP remote : %d", errno);
		ret = -errno;
	}

	return ret;
}


int send_udp(uint8_t * data, uint8_t size)
{
    if(!udp_started){
        start_udp();
	    udp_started = true;
    }

	int ret;

	ret = send(sock, data, size, 0);

	LOG_DBG("UDP: Sent %d bytes", size);

	return ret < 0 ? -EIO : 0;

}
```
