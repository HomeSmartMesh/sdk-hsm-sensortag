## CMakeLists.txt
```
set(BOARD_ROOT ${CMAKE_CURRENT_SOURCE_DIR}/../..)

cmake_minimum_required(VERSION 3.13.1)
find_package(Zephyr REQUIRED HINTS $ENV{ZEPHYR_BASE})
project(adc_battery)

target_sources(app PRIVATE src/main.cpp)
```

## prj.conf
```kconfig
CONFIG_GPIO=y
CONFIG_SERIAL=y

# Power optimization
CONFIG_PM=y
CONFIG_PM_DEVICE=y
CONFIG_SERIAL=n
CONFIG_LOG=n
CONFIG_CONSOLE=n
CONFIG_UART_CONSOLE=n
CONFIG_RTT_CONSOLE=n
CONFIG_USE_SEGGER_RTT=n
CONFIG_PRINTK=n

# message generation
CONFIG_NEWLIB_LIBC=y
CONFIG_NEWLIB_LIBC_FLOAT_PRINTF=y

# RF Mesh
CONFIG_ESB=y
CONFIG_SIMPLEMESH=y
CONFIG_SM_CHANNEL=20
CONFIG_SM_LISTENER=n
```

## src/main.c
```c
#include <zephyr.h>
#include <logging/log.h>
#include <stdio.h>
#include <usb/usb_device.h>

#include "simplemesh.h"

LOG_MODULE_REGISTER(main, LOG_LEVEL_DBG);

void main(void)
{
	LOG_INF("Hello Simple Mesh from Sensor Tag");

	sm_start();

	int loop = 0;
	long unsigned int id0 = NRF_FICR->DEVICEID[0];//just for type casting and readable printing
	long unsigned int id1 = NRF_FICR->DEVICEID[1];
	while (1) {
		char message[50];
		sprintf(message,"simplemesh/%04lX%04lX{\"alive\":%d}",id0,id1,loop);
		mesh_bcast_text(message);
		printk("%s\n",message);
		k_sleep(K_SECONDS(4));
		loop++;
	}
}
```
