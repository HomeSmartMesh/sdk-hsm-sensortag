## CMakeLists.txt
```
set(BOARD_ROOT ${CMAKE_CURRENT_SOURCE_DIR}/../..)

cmake_minimum_required(VERSION 3.13.1)
set(BOARD nrf52840_sensortag)
find_package(Zephyr REQUIRED HINTS $ENV{ZEPHYR_BASE})
project(sesnors_broadcast)

target_sources(app PRIVATE src/main.c src/udp_client.c)
```

## prj.conf
```kconfig
CONFIG_I2C=y
CONFIG_SENSOR=y
CONFIG_VEML6030=y
CONFIG_MS8607=y

CONFIG_ADC=y
CONFIG_BATTERY=y
CONFIG_APP_OT=y
CONFIG_APP_FLASH=y
CONFIG_APP_LED=y


CONFIG_GPIO=y
CONFIG_PWM=y
CONFIG_PINCTRL=y



CONFIG_OPENTHREAD_NORDIC_LIBRARY_MASTER=y
CONFIG_NETWORKING=y
CONFIG_NET_L2_OPENTHREAD=y
CONFIG_NET_IPV6_NBR_CACHE=n
CONFIG_NET_IPV6_MLD=n
CONFIG_NET_SOCKETS=y
CONFIG_NET_SOCKETS_POLL_MAX=5
CONFIG_NET_SOCKETS_POSIX_NAMES=y
CONFIG_NET_CONNECTION_MANAGER=n
CONFIG_NET_IPV4=n
CONFIG_NET_IPV6=y
CONFIG_OPENTHREAD_FTD=n
CONFIG_OPENTHREAD_NORDIC_LIBRARY_MTD=y
CONFIG_OPENTHREAD_MTD=y
CONFIG_OPENTHREAD_MTD_SED=y
CONFIG_OPENTHREAD_MANUAL_START=n
CONFIG_MBEDTLS_SHA1_C=n
CONFIG_FPU=y
CONFIG_OPENTHREAD_JOINER=y
CONFIG_OPENTHREAD_JOINER_AUTOSTART=y
CONFIG_OPENTHREAD_JOINER_PSKD="ABCDE2"
CONFIG_OPENTHREAD_SLAAC=y

CONFIG_NEWLIB_LIBC=y
CONFIG_NEWLIB_LIBC_FLOAT_PRINTF=y

#prevents Stack overflow on k_work_
CONFIG_SYSTEM_WORKQUEUE_STACK_SIZE=4096
CONFIG_MAIN_STACK_SIZE=8192

#Low power config
CONFIG_PM=y
CONFIG_PM_DEVICE=y
CONFIG_SERIAL=n
CONFIG_LOG=n
CONFIG_CONSOLE=n
CONFIG_UART_CONSOLE=n
CONFIG_RTT_CONSOLE=n
CONFIG_USE_SEGGER_RTT=n
CONFIG_PRINTK=n
CONFIG_NETWORKING=y
CONFIG_OPENTHREAD_SHELL=n
CONFIG_OPENTHREAD_POLL_PERIOD=600000
########################################
#CONFIG_INIT_STACKS=y
#CONFIG_NET_UDP=y
#CONFIG_NET_TCP=n
#CONFIG_NET_CONNECTION_MANAGER=y
#CONFIG_NET_PKT_RX_COUNT=1
#CONFIG_NET_PKT_TX_COUNT=4
#CONFIG_NET_BUF_RX_COUNT=2
#CONFIG_NET_BUF_TX_COUNT=8
#CONFIG_NET_CONTEXT_NET_PKT_POOL=y
#CONFIG_NET_IF_UNICAST_IPV6_ADDR_COUNT=3
#CONFIG_NET_IF_MCAST_IPV6_ADDR_COUNT=4
#CONFIG_NET_MAX_CONTEXTS=2
```

## prj-fixed.conf
```kconfig
# Peripherals
#CONFIG_ADC=y
#CONFIG_BATTERY=y

CONFIG_I2C=y
CONFIG_SENSOR=y
CONFIG_VEML6030=y
CONFIG_MS8607=y

#CONFIG_ADC=y
#CONFIG_APP_BATTERY=y
CONFIG_APP_OT=y

CONFIG_GPIO=y
CONFIG_PINCTRL=y

CONFIG_WATCHDOG=y
CONFIG_WDT_DISABLE_AT_BOOT=n


CONFIG_OPENTHREAD_NORDIC_LIBRARY_MASTER=y
CONFIG_NETWORKING=y
CONFIG_NET_L2_OPENTHREAD=y
CONFIG_NET_IPV6_NBR_CACHE=n
CONFIG_NET_IPV6_MLD=n
CONFIG_NET_SOCKETS=y
CONFIG_NET_SOCKETS_POLL_MAX=5
CONFIG_NET_SOCKETS_POSIX_NAMES=y
CONFIG_NET_CONNECTION_MANAGER=n
CONFIG_NET_IPV4=n
CONFIG_NET_IPV6=y
CONFIG_OPENTHREAD_FTD=n
CONFIG_OPENTHREAD_NORDIC_LIBRARY_MTD=y
CONFIG_OPENTHREAD_MTD=y
CONFIG_OPENTHREAD_MTD_SED=y
CONFIG_OPENTHREAD_MANUAL_START=n
CONFIG_MBEDTLS_SHA1_C=n
CONFIG_FPU=y



CONFIG_OPENTHREAD_CHANNEL=24
CONFIG_OPENTHREAD_PANID=4660
CONFIG_OPENTHREAD_NETWORK_NAME="ThreadMatter"
CONFIG_OPENTHREAD_XPANID="11:11:11:11:22:22:22:22"
CONFIG_OPENTHREAD_NETWORKKEY="00:11:22:33:44:55:66:77:88:99:aa:bb:cc:dd:ee:ff"


CONFIG_OPENTHREAD_SLAAC=y

CONFIG_NEWLIB_LIBC=y
CONFIG_NEWLIB_LIBC_FLOAT_PRINTF=y

#Low power config
#CONFIG_PM=y
#CONFIG_PM_DEVICE=y
#CONFIG_SERIAL=n
#CONFIG_LOG=n
#CONFIG_CONSOLE=n
#CONFIG_UART_CONSOLE=n
#CONFIG_RTT_CONSOLE=n
#CONFIG_USE_SEGGER_RTT=n
#CONFIG_PRINTK=n
#CONFIG_NETWORKING=y
#CONFIG_OPENTHREAD_SHELL=n
#CONFIG_OPENTHREAD_POLL_PERIOD=600000
########################################
#CONFIG_MAIN_STACK_SIZE=2048
#CONFIG_INIT_STACKS=y
#CONFIG_NET_UDP=y
#CONFIG_NET_TCP=n
#CONFIG_NET_CONNECTION_MANAGER=y
#CONFIG_NET_PKT_RX_COUNT=1
#CONFIG_NET_PKT_TX_COUNT=4
#CONFIG_NET_BUF_RX_COUNT=2
#CONFIG_NET_BUF_TX_COUNT=8
#CONFIG_NET_CONTEXT_NET_PKT_POOL=y
#CONFIG_NET_IF_UNICAST_IPV6_ADDR_COUNT=3
#CONFIG_NET_IF_MCAST_IPV6_ADDR_COUNT=4
#CONFIG_NET_MAX_CONTEXTS=2
```

## src/main.c
```c
#include <zephyr/kernel.h>
#include <zephyr/logging/log.h>
#include <zephyr/net/socket.h>
#include <zephyr/net/net_if.h>
#include <stdio.h>
#include <zephyr/drivers/gpio.h>
#include <zephyr/drivers/sensor.h>
#include <sensor/veml6030.h>
#include <sensor/ms8607.h>
#include <zephyr/sys/printk.h>
#include <zephyr/sys/reboot.h>

#include <zephyr/net/openthread.h>
#include <openthread/thread.h>

#include "battery.h"
#include "udp_client.h"
#include "app_ot.h"
#include "flash_settings_storage.h"
#ifdef CONFIG_APP_LED
	#include "app_led.h"
#else
	#define app_led_init()
	#define app_led_blink_blue(...)
	#define app_led_blink_red(...)
	#define app_led_blink_green(...)
#endif

LOG_MODULE_REGISTER(main, LOG_LEVEL_DBG);
//#define CONFIG_GPIO_DEBUG
#ifdef CONFIG_GPIO_DEBUG
	#include <zephyr/drivers/gpio.h>
	#define DEBUG_PIN_APP 	 2
	#define DEBUG_PIN_LOOP	29

	#define APP_SET 	gpio_pin_set(gpio_dev, DEBUG_PIN_APP, 1)
	#define APP_CLEAR 	gpio_pin_set(gpio_dev, DEBUG_PIN_APP, 0)
	#define LOOP_SET 	gpio_pin_set(gpio_dev, DEBUG_PIN_LOOP, 1)
	#define LOOP_CLEAR 	gpio_pin_set(gpio_dev, DEBUG_PIN_LOOP, 0)

	const struct device *gpio_dev;
	void gpio_pin_init()
	{
		gpio_dev = device_get_binding(DT_LABEL(DT_NODELABEL(gpio0)));
		gpio_pin_configure(gpio_dev, DEBUG_PIN_APP, GPIO_OUTPUT_ACTIVE);
		gpio_pin_configure(gpio_dev, DEBUG_PIN_LOOP, GPIO_OUTPUT_ACTIVE);
	}
#else
	#define APP_SET
	#define APP_CLEAR
	#define LOOP_SET
	#define LOOP_CLEAR
	#define gpio_pin_init()
#endif

#define SLEEP_DETACHED_SEC 40U
#define SLEEP_CYCLE_SEC 30U

#define SLEEP_QUICK_REBOOT_SEC 3U

#define LED_PWM_RATIO 0.01

char uid_text[20];

const struct device *light_dev = DEVICE_DT_GET_ONE(vishay_veml6030);


void report_sensors(int count,bool send){
	APP_SET;
	battery_start();
	k_sleep(K_MSEC(10));
	int32_t voltage_mv = battery_get_mv();
	float voltage = voltage_mv;
	voltage /= 1000;
	float light = veml6030_auto_measure(light_dev);
	float t, p, h;
	enum ms8607_status status = ms8607_read_temperature_pressure_humidity(&t,&p,&h);
	if(status != ms8607_status_ok){
		LOG_ERR("ms8607> status = %d",status);
	}
	APP_CLEAR;

	char message[250];
	int size = sprintf(message,"thread_tags/%s{\"alive\":%d,\"voltage\":%.3f,\"light\":%0.3f,\"temperature\":%.2f,\"humidity\":%.2f,\"pressure\":%.2f}",
								uid_text,count, voltage, light, t, h, p);
	if(send){
		APP_SET;
		send_udp(message, size);
		APP_CLEAR;
	}
	LOG_INF("%s",message);
}

void main(void)
{
	app_led_init();
	//   ---    handle quick reboot   ---
	uint32_t quick_rebout_count;
	fss_read_word(&quick_rebout_count);
	LOG_INF("Quick reboot count:%u",quick_rebout_count);
	if(quick_rebout_count == 2){
		LOG_INF("Quick reboot count limit reached - reset counter");
		quick_rebout_count = 0;
		fss_write_word(&quick_rebout_count);
		LOG_INF("Performing factory reset");
		k_sleep(K_MSEC(500));
		app_led_blink_blue(LED_PWM_RATIO,100,500);
		app_led_blink_blue(LED_PWM_RATIO,100,500);
		app_led_blink_blue(LED_PWM_RATIO,100,500);
		quick_reboot_factoryreset();
	}
	quick_rebout_count++;
	fss_write_word(&quick_rebout_count);

	gpio_pin_init();
	APP_CLEAR;
	LOOP_CLEAR;
	k_sleep(K_MSEC(10));

	LOG_INF("Hello Sensors Broadcast");

	battery_init();
	app_ot_init();//logs joiner info and initializes reset buttons
	//signal that now buttons can be pressed
	k_sleep(K_MSEC(100));
	app_led_blink_red(LED_PWM_RATIO,100,100);
	app_led_blink_green(LED_PWM_RATIO,100,100);
	app_led_blink_blue(LED_PWM_RATIO,100,100);
	//getting the ms8607 is not needed due to the hardcoding of i2c adresses, multi instance is not possible
	//const struct device *env_dev = device_get_binding(DT_LABEL(DT_INST(0, teconnectivity_ms8607)));
	if(ms8607_is_connected()){
		LOG_INF("ms8607> connected");
	}else{
		LOG_ERR("ms8607> not connected");
	}

	long unsigned int id0 = NRF_FICR->DEVICEID[0];//just for type casting and readable printing
	long unsigned int id1 = NRF_FICR->DEVICEID[1];
	sprintf(uid_text,"%04lX%04lX",id0,id1);
	LOG_INF("Device ID:%s",uid_text);

	//long unsigned int abs_reboot = NRF_UICR->CUSTOMER[0];
	//abs_reboot++;
	//NRF_UICR->CUSTOMER[0] = abs_reboot;
	//LOG_INF("Abs reboot count (CUSTOMER[0]):%08lX",abs_reboot);

	k_sleep(K_MSEC(SLEEP_QUICK_REBOOT_SEC*1000));
	//after SLEEP_QUICK_REBOOT_SEC, disable quick reboot
	quick_rebout_count = 0;
	fss_write_word(&quick_rebout_count);
	k_sleep(K_MSEC(100));
	app_led_blink_red(LED_PWM_RATIO,100,100);
	app_led_blink_green(LED_PWM_RATIO,100,100);
	app_led_blink_blue(LED_PWM_RATIO,100,100);

	int count = 0;
	while (1) {
		LOOP_SET;
		LOG_INF("starting loop (%d)",count);

		otDeviceRole role = ot_app_role();
		bool send = (role >= OT_DEVICE_ROLE_CHILD);
		report_sensors(count,send);

		if(role <= OT_DEVICE_ROLE_DETACHED){
			app_led_blink_blue(LED_PWM_RATIO,100,100);
			app_led_blink_blue(LED_PWM_RATIO,100,100);
			LOG_INF("role: %s; sleeping %d sec cout = %d",
				(role == OT_DEVICE_ROLE_DISABLED)?"Disabled":"Detached",
				SLEEP_DETACHED_SEC,count);
			k_sleep(K_MSEC(SLEEP_DETACHED_SEC*1000));
			role = ot_app_role();
			if(role <= OT_DEVICE_ROLE_DISABLED){
				app_led_blink_red(LED_PWM_RATIO,100,100);
				app_led_blink_red(LED_PWM_RATIO,100,100);
				app_led_blink_red(LED_PWM_RATIO,100,100);
				sys_reboot(SYS_REBOOT_WARM);
			}
		}else{
			app_led_blink_green(LED_PWM_RATIO,100,100);
			LOG_INF("sleeping %d sec count = %d",SLEEP_CYCLE_SEC,count);
			k_sleep(K_MSEC(SLEEP_CYCLE_SEC*1000));
		}
		count++;
		LOOP_CLEAR;
	}
}
```
