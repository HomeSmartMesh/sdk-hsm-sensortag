## prj.conf
```kconfig
#CONFIG_SPEED_OPTIMIZATIONS=y
CONFIG_GPIO=y

#nRF Networking
CONFIG_ESB=y
CONFIG_SIMPLEMESH=y

#C++
CONFIG_CPLUSPLUS=y
CONFIG_LIB_CPLUSPLUS=y
CONFIG_STD_CPP11=n
CONFIG_STD_CPP17=y

# Console (printk printf)
CONFIG_CONSOLE=y
CONFIG_UART_CONSOLE=y
CONFIG_RTT_CONSOLE=n
CONFIG_STDOUT_CONSOLE=y

#printf
CONFIG_NEWLIB_LIBC=y
CONFIG_NEWLIB_LIBC_FLOAT_PRINTF=y
CONFIG_PRINTK=y

#Stack
CONFIG_MAIN_STACK_SIZE=2048

#safe silence of ABI change warning as using gcc > 7 https://github.com/nlohmann/json/issues/1861
CONFIG_COMPILER_OPT="-Wno-psabi"
```

## overlay-debug.conf
```kconfig
CONFIG_BOOT_BANNER=y
CONFIG_USE_SEGGER_RTT=y
CONFIG_RTT_CONSOLE=y
# Log => RTT, Shell => RTT

# Log
CONFIG_LOG=y
CONFIG_LOG_BACKEND_RTT=n
CONFIG_LOG_BACKEND_UART=y

# Shell
CONFIG_SHELL=y
CONFIG_SHELL_BACKEND_RTT=y
CONFIG_SHELL_BACKEND_SERIAL=n
```

## src/main.cpp
```c
#include <zephyr.h>
#include <logging/log.h>
#include <stdio.h>
#include <usb/usb_device.h>
#include <simplemesh.h>
#include <json.hpp>
#include <string>

std::string uid;
std::string full_topic;
json j;

LOG_MODULE_REGISTER(main, LOG_LEVEL_DBG);

void rx_topic_json_handler(std::string &topic, json &data)
{
	printk("topic = %s ; json :\n",topic.c_str());
	printk("%s\n",data.dump(2).c_str());
}

void main(void)
{
	#ifdef CONFIG_USB
		int ret;
		ret = usb_enable(NULL);
		if (ret != 0) {
			LOG_ERR("Failed to enable USB");
			return;
		}
	#endif

	uid = sm_get_uid();
	full_topic = sm_get_topic();
	printk("Hello Simple Mesh from DWM1001 UID (%s)\n",uid.c_str());
	printk("broadcasting on self topic (%s)\n",full_topic.c_str());

	sm_set_callback_rx_json(rx_topic_json_handler);
	sm_start();

	int loop = 0;
	while (1) {
		j["alive"] = loop;
		mesh_bcast_json(j);
		printk("broadcasted : %s\n",j.dump().c_str());
		k_sleep(K_SECONDS(5));
		loop++;
	}
}
```
