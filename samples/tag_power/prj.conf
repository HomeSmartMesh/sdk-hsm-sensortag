## prj.conf
```kconfig
#Power management
CONFIG_PM=y
# Required to disable default behavior of deep sleep on timeout
CONFIG_PM_DEVICE=y
CONFIG_GPIO=y
# Optional select RAM retention (nRF52 only)
#CONFIG_APP_RETENTION=y

CONFIG_PM_POLICY_RESIDENCY=n
CONFIG_PM_POLICY_APP=y

CONFIG_SERIAL=n

# Logging
CONFIG_LOG=y
CONFIG_LOG_BACKEND_RTT=y
CONFIG_LOG_BACKEND_UART=n
CONFIG_BOOT_BANNER=y
CONFIG_USE_SEGGER_RTT=y
CONFIG_CONSOLE=y
CONFIG_UART_CONSOLE=n
CONFIG_RTT_CONSOLE=y
```

## prj-high.conf
```kconfig
CONFIG_GPIO=y
CONFIG_SERIAL=n


# Logging
CONFIG_LOG=y
CONFIG_LOG_BACKEND_RTT=y
CONFIG_LOG_BACKEND_UART=n
CONFIG_BOOT_BANNER=y
CONFIG_USE_SEGGER_RTT=y
CONFIG_CONSOLE=y
CONFIG_UART_CONSOLE=n
CONFIG_RTT_CONSOLE=y

CONFIG_NEWLIB_LIBC=y
CONFIG_NEWLIB_LIBC_FLOAT_PRINTF=y
```

## prj-low.conf
```kconfig
#Power management
CONFIG_PM=y
# Required to disable default behavior of deep sleep on timeout
CONFIG_PM_DEVICE=y
# Optional select RAM retention (nRF52 only)
#CONFIG_APP_RETENTION=y

CONFIG_TICKLESS_KERNEL=y

CONFIG_TIMESLICING=n

CONFIG_PM_POLICY_RESIDENCY=n
CONFIG_PM_POLICY_APP=y

CONFIG_GPIO=y

CONFIG_DEBUG_THREAD_INFO=y
CONFIG_THREAD_MONITOR=y

CONFIG_SERIAL=n

# Logging
CONFIG_LOG=n
CONFIG_LOG_BACKEND_RTT=n
CONFIG_LOG_BACKEND_UART=n
CONFIG_BOOT_BANNER=n
CONFIG_USE_SEGGER_RTT=n
CONFIG_CONSOLE=n
CONFIG_UART_CONSOLE=n
CONFIG_RTT_CONSOLE=n
```

## prj-lowpower.conf
```kconfig
#Power management
CONFIG_PM=y
# Required to disable default behavior of deep sleep on timeout
CONFIG_PM_DEVICE=y
# Optional select RAM retention (nRF52 only)
#CONFIG_APP_RETENTION=y

CONFIG_PM_POLICY_RESIDENCY=n
CONFIG_PM_POLICY_APP=y

CONFIG_GPIO=y

CONFIG_DEBUG_THREAD_INFO=y
CONFIG_THREAD_MONITOR=y

CONFIG_SERIAL=n

# Logging
CONFIG_LOG=n
CONFIG_LOG_BACKEND_RTT=n
CONFIG_LOG_BACKEND_UART=n
CONFIG_BOOT_BANNER=n
CONFIG_USE_SEGGER_RTT=n
CONFIG_CONSOLE=n
CONFIG_UART_CONSOLE=n
CONFIG_RTT_CONSOLE=n
```

## prj-simple.conf
```kconfig
CONFIG_SERIAL=n
CONFIG_LOG=n
CONFIG_CONSOLE=n
CONFIG_UART_CONSOLE=n
CONFIG_RTT_CONSOLE=n
CONFIG_USE_SEGGER_RTT=n

CONFIG_PRINTK=n

#CONFIG_MULTITHREADING=n
#CONFIG_TIMESLICING=n
#CONFIG_SYSTEM_CLOCK_SLOPPY_IDLE=y
```

## trace.conf
```kconfig
CONFIG_GPIO=y

#Tracing
#CONFIG_TRACING=y
#CONFIG_SEGGER_SYSTEMVIEW=y
#CONFIG_THREAD_NAME=y
#CONFIG_SEGGER_SYSTEMVIEW_BOOT_ENABLE=y
```

## src/main.c
```c
//reference sample : zephyr\samples\boards\nrf\system_off 2.4.99

#include <zephyr.h>
#include <logging/log.h>
#include <stdio.h>

#include <device.h>
#include <devicetree.h>
#include <drivers/gpio.h>

#include <hal/nrf_power.h>
#include <hal/nrf_clock.h>
#include <drivers/timer/system_timer.h>

LOG_MODULE_REGISTER(main, LOG_LEVEL_INF);

#define WITH_GPIO

#ifdef WITH_GPIO
	#define DEBUG_PIN_APP 	 2
	#define DEBUG_PIN_OS	29

	#define DEBUG_PIN_29_SET 	(*(int * const)0x50000508) = 0x20000000
	#define DEBUG_PIN_29_CLEAR 	(*(int *) 0x5000050C) = 0x20000000

	#define debug_up()		gpio_pin_set(gpio_dev, DEBUG_PIN_APP, 1)
	#define debug_down()	gpio_pin_set(gpio_dev, DEBUG_PIN_APP, 0)
	#define debug_os_down()	gpio_pin_set(gpio_dev, DEBUG_PIN_OS, 0)

const struct device *gpio_dev;
void gpio_pin_init()
{
	gpio_dev = device_get_binding(DT_LABEL(DT_NODELABEL(gpio0)));
	int ret = gpio_pin_configure(gpio_dev, DEBUG_PIN_APP, GPIO_OUTPUT_ACTIVE);
	if (ret < 0) {
		LOG_ERR("gpio_pin_configure() failed");
	}
	ret = gpio_pin_configure(gpio_dev, DEBUG_PIN_OS, GPIO_OUTPUT_ACTIVE);
	if (ret < 0) {
		LOG_ERR("gpio_pin_configure() failed");
	}
}
#else
	#define debug_up()		
	#define debug_down()	
	#define debug_os_down()	
	#define gpio_pin_init()
#endif

void test_delay(int ms)
{
	debug_up();
	k_sleep(K_MSEC(ms));
	debug_down();
	k_sleep(K_MSEC(10));
}

void main(void)
{
	gpio_pin_init();
	debug_down();
	debug_os_down();
	LOG_INF("Hello Power management");

	while (1) {
		test_delay(1);
		test_delay(2);
		test_delay(5);
		test_delay(5);
		test_delay(5);
		test_delay(5);
		test_delay(5);
		test_delay(20);
		test_delay(50);
		test_delay(100);
		k_busy_wait(50*1000);//@3 mA
	}
}
```
