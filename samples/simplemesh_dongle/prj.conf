## prj.conf
```kconfig
CONFIG_BOARD_HAS_NRF5_BOOTLOADER=n

CONFIG_ESB=y
CONFIG_SIMPLEMESH=y

CONFIG_GPIO=y
CONFIG_SERIAL=y

# Logging
CONFIG_LOG=y
CONFIG_LOG_BACKEND_RTT=y
CONFIG_LOG_BACKEND_UART=y
CONFIG_BOOT_BANNER=y
CONFIG_USE_SEGGER_RTT=y
CONFIG_CONSOLE=y
CONFIG_UART_CONSOLE=y
CONFIG_RTT_CONSOLE=y

CONFIG_CONSOLE_SUBSYS=y
CONFIG_CONSOLE_GETLINE=y

#printf
CONFIG_NEWLIB_LIBC=y
CONFIG_NEWLIB_LIBC_FLOAT_PRINTF=y
CONFIG_PRINTK=y

#C++
CONFIG_CPLUSPLUS=y
CONFIG_LIB_CPLUSPLUS=y
CONFIG_STD_CPP11=n
CONFIG_STD_CPP17=y
```

## prj-dwm.conf
```kconfig
CONFIG_ESB=y
CONFIG_SIMPLEMESH=y
CONFIG_SM_COORDINATOR=n
CONFIG_SM_SNIFFER=y

CONFIG_GPIO=y
CONFIG_SERIAL=y

CONFIG_BOOT_BANNER=y

CONFIG_LOG=n

# Console (printk printf)
CONFIG_CONSOLE=y
CONFIG_UART_CONSOLE=y
CONFIG_RTT_CONSOLE=n
CONFIG_STDOUT_CONSOLE=y


CONFIG_CONSOLE_SUBSYS=y
CONFIG_CONSOLE_GETLINE=y

#printf
CONFIG_NEWLIB_LIBC=y
CONFIG_NEWLIB_LIBC_FLOAT_PRINTF=y
CONFIG_PRINTK=y

#C++
CONFIG_CPLUSPLUS=y
CONFIG_LIB_CPLUSPLUS=y
CONFIG_STD_CPP11=n
CONFIG_STD_CPP17=y

#Stack
CONFIG_MAIN_STACK_SIZE=4096

#safe silence of ABI change warning as using gcc > 7 https://github.com/nlohmann/json/issues/1861
CONFIG_COMPILER_OPT="-Wno-psabi"
```

## src/main.c
```c
#include <zephyr.h>
#include <logging/log.h>
#include <stdio.h>
#include <usb/usb_device.h>
#include <console/console.h>

#include "simplemesh.h"

LOG_MODULE_REGISTER(main, LOG_LEVEL_DBG);

char uid[20];

#define STACKSIZE 1025
#define PRIORITY 10
void console_thread();

K_SEM_DEFINE(sem_print, 1, 1);
K_THREAD_DEFINE(sm_console, STACKSIZE, console_thread, 
                NULL, NULL, NULL, PRIORITY, 0, 0);

void safe_print(const char * text)
{
	k_sem_take(&sem_print, K_FOREVER);
	printk("%s\n", text);
	k_sem_give(&sem_print);
}

void console_thread()
{
	console_getline_init();
	while (1) {
		printk(">");
		char *text = console_getline();
		mesh_bcast_text(text);
	}
}

void rx_handler(message_t* msg)
{
	if(msg->pid == Mesh_Pid_Text){
		msg->payload[msg->payload_length] = '\0';
		safe_print((char*)msg->payload);
	}
}

void main(void)
{
	#ifdef CONFIG_USB
		int ret;
		ret = usb_enable(NULL);
		if (ret != 0) {
			LOG_ERR("Failed to enable USB");
			return;
		}
		//TODO wait for USB to be connected
	#endif

	k_sleep(K_SECONDS(5));
	sm_start(rx_handler);
	sm_get_uid(uid);
	printk("Hello Simple Mesh Started from UID (%s)",uid);

	int loop = 0;
	while (1) {
		char message[50];
		sprintf(message,"sm/%s{\"alive\":%d}",uid,loop);
		mesh_bcast_text(message);
		k_sleep(K_SECONDS(20));
		loop++;
	}
}
```

## src/main.cpp
```c
#include <zephyr.h>
#include <logging/log.h>
#include <stdio.h>
#include <usb/usb_device.h>
#include <console/console.h>

#include <json.hpp>
#include <simplemesh.h>

LOG_MODULE_REGISTER(main, LOG_LEVEL_DBG);
json j;

#define STACKSIZE 1025
#define PRIORITY 10
void console_thread();

K_SEM_DEFINE(sem_print, 1, 1);
K_THREAD_DEFINE(sm_console, STACKSIZE, console_thread, 
                NULL, NULL, NULL, PRIORITY, 0, 0);

void console_thread()
{
	console_getline_init();
	while (1) {
		printf(">");
		char *text = console_getline();
		mesh_bcast_text(text);
	}
}

void main(void)
{
	#ifdef CONFIG_USB
		int ret;
		ret = usb_enable(NULL);
		if (ret != 0) {
			LOG_ERR("Failed to enable USB");
			return;
		}
		//TODO wait for USB to be connected
	#endif

	k_sleep(K_SECONDS(5));
	sm_start();
	std::string uid = sm_get_uid();
	printf("main>Simple Mesh UID [%s]\n",uid.c_str());

	std::string topic = sm_get_topic();
	j["sniffer"] = "started";
	mesh_bcast_json(j);
	printf("%s\n",j.dump().c_str());
}
```
