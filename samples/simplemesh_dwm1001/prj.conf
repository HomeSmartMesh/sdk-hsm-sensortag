## prj.conf
```kconfig
#CONFIG_SPEED_OPTIMIZATIONS=y
CONFIG_GPIO=y

#nRF Networking
CONFIG_ESB=y
CONFIG_SIMPLEMESH=y

#C++
CONFIG_CPLUSPLUS=y
CONFIG_LIB_CPLUSPLUS=y
CONFIG_STD_CPP11=n
CONFIG_STD_CPP17=y

# Console (printk printf)
CONFIG_CONSOLE=y
CONFIG_UART_CONSOLE=y
CONFIG_RTT_CONSOLE=n
CONFIG_STDOUT_CONSOLE=y

#printf
CONFIG_NEWLIB_LIBC=y
CONFIG_NEWLIB_LIBC_FLOAT_PRINTF=y
CONFIG_PRINTK=y

#Stack
CONFIG_MAIN_STACK_SIZE=2048
```

## overlay-debug.conf
```kconfig
CONFIG_LOG=n
CONFIG_LOG_BACKEND_RTT=n
CONFIG_LOG_BACKEND_UART=n
CONFIG_BOOT_BANNER=y
CONFIG_USE_SEGGER_RTT=y

CONFIG_CONSOLE=y
CONFIG_UART_CONSOLE=n
CONFIG_RTT_CONSOLE=y

# shell
CONFIG_SHELL=y
CONFIG_SHELL_BACKEND_RTT=y
CONFIG_SHELL_BACKEND_SERIAL=n

# Logging
CONFIG_LOG=y
CONFIG_PRINTK=y
```

## src/main.c
```c
#include <zephyr.h>
#include <logging/log.h>
#include <stdio.h>
#include <usb/usb_device.h>

#include "simplemesh.h"

LOG_MODULE_REGISTER(main, LOG_LEVEL_DBG);

void rx_handler(message_t* msg)
{
	if(msg->pid == Mesh_Pid_Text){
		msg->payload[msg->payload_length] = '\0';
		printk("%s\n",(char*)msg->payload);
	}
}

void main(void)
{
	#ifdef CONFIG_USB
		int ret;
		ret = usb_enable(NULL);
		if (ret != 0) {
			LOG_ERR("Failed to enable USB");
			return;
		}
	#endif
	LOG_INF("Hello Simple Mesh on DWM1001");

	sm_start(rx_handler);

	int loop = 0;
	long unsigned int id0 = NRF_FICR->DEVICEID[0];//just for type casting and readable printing
	long unsigned int id1 = NRF_FICR->DEVICEID[1];
	while (1) {
		char message[50];
		sprintf(message,"simplemesh/%04lX%04lX{\"alive\":%d}",id0,id1,loop);
		mesh_bcast_text(message);
		printk("%s\n",message);
		k_sleep(K_SECONDS(20));
		loop++;
	}
}
```

## src/main.cpp
```c
#include <zephyr.h>
#include <logging/log.h>
#include <stdio.h>
#include <usb/usb_device.h>
#include <simplemesh.h>
#include <json.hpp>
#include <string>

std::string uid;
std::string full_topic;
json j;

LOG_MODULE_REGISTER(main, LOG_LEVEL_DBG);

void rx_topic_json_handler(std::string &topic, json &data)
{
	printk("topic = %s ; json :\n",topic.c_str());
	printk("%s\n",data.dump(2).c_str());
}

void main(void)
{
	#ifdef CONFIG_USB
		int ret;
		ret = usb_enable(NULL);
		if (ret != 0) {
			LOG_ERR("Failed to enable USB");
			return;
		}
	#endif

	uid = sm_get_uid();
	full_topic = sm_get_topic();
	printk("Hello Simple from DWM1001 UID (%s)",uid.c_str());

	sm_set_callback_rx_json(rx_topic_json_handler);
	sm_start();

	int loop = 0;
	while (1) {
		j["alive"] = loop;
		std::string message = full_topic + j.dump();
		mesh_bcast_string(message);
		printk("%s\n",message.c_str());
		k_sleep(K_SECONDS(5));
		loop++;
	}
}
```
