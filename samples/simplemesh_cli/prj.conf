## prj.conf
```kconfig
CONFIG_SPEED_OPTIMIZATIONS=y
CONFIG_REBOOT=y

CONFIG_BOARD_HAS_NRF5_BOOTLOADER=n

CONFIG_ESB=y
CONFIG_SIMPLEMESH=y
CONFIG_SM_COORDINATOR=y

CONFIG_GPIO=y
CONFIG_SERIAL=y

CONFIG_BOOT_BANNER=n

CONFIG_LOG=n

# Console (printk printf)
CONFIG_CONSOLE=y
CONFIG_UART_CONSOLE=y
CONFIG_RTT_CONSOLE=n
CONFIG_STDOUT_CONSOLE=y


CONFIG_CONSOLE_SUBSYS=y
CONFIG_CONSOLE_GETLINE=y

#printf
CONFIG_NEWLIB_LIBC=y
CONFIG_NEWLIB_LIBC_FLOAT_PRINTF=y
CONFIG_PRINTK=y

#C++
CONFIG_CPLUSPLUS=y
CONFIG_LIB_CPLUSPLUS=y
CONFIG_STD_CPP11=n
CONFIG_STD_CPP17=y
CONFIG_EXCEPTIONS=y

#Stack
CONFIG_MAIN_STACK_SIZE=4096

#safe silence of ABI change warning as using gcc > 7 https://github.com/nlohmann/json/issues/1861
CONFIG_COMPILER_OPT="-Wno-psabi"
```

## prj-dwm.conf
```kconfig
CONFIG_ESB=y
CONFIG_SIMPLEMESH=y
CONFIG_SM_COORDINATOR=n
CONFIG_SM_SNIFFER=y

CONFIG_GPIO=y
CONFIG_SERIAL=y

CONFIG_BOOT_BANNER=n

CONFIG_LOG=n

# Console (printk printf)
CONFIG_CONSOLE=y
CONFIG_UART_CONSOLE=y
CONFIG_RTT_CONSOLE=n
CONFIG_STDOUT_CONSOLE=y


CONFIG_CONSOLE_SUBSYS=y
CONFIG_CONSOLE_GETLINE=y

#printf
CONFIG_NEWLIB_LIBC=y
CONFIG_NEWLIB_LIBC_FLOAT_PRINTF=y
CONFIG_PRINTK=y

#C++
CONFIG_CPLUSPLUS=y
CONFIG_LIB_CPLUSPLUS=y
CONFIG_STD_CPP11=n
CONFIG_STD_CPP17=y
CONFIG_EXCEPTIONS=n

#Stack
CONFIG_MAIN_STACK_SIZE=4096

#safe silence of ABI change warning as using gcc > 7 https://github.com/nlohmann/json/issues/1861
CONFIG_COMPILER_OPT="-Wno-psabi"
```

## src/main.cpp
```c
#include <zephyr.h>
#include <logging/log.h>
#include <stdio.h>
#include <usb/usb_device.h>
#include <console/console.h>
#include <sys/reboot.h>

#include <json.hpp>
#include <simplemesh.h>

LOG_MODULE_REGISTER(main, LOG_LEVEL_DBG);
json j;
extern bool critical_parse;


#if (CONFIG_SM_GPIO_DEBUG)
	#include <drivers/gpio.h>
	const struct device *gpio_dev;

	#if CONFIG_SM_GPIO_DEBUG
		//0.625 us per toggle
		#define PIN_SM_SET 		gpio_pin_set(gpio_dev, CONFIG_SM_PIN_APP, 1)
		#define PIN_SM_CLEAR 	gpio_pin_set(gpio_dev, CONFIG_SM_PIN_APP, 0)
	#else
		#define PIN_SM_SET
		#define PIN_SM_CLEAR
	#endif
#endif

void app_gpio_init()
{
	#if (CONFIG_SM_GPIO_DEBUG)
		gpio_dev = device_get_binding(DT_LABEL(DT_NODELABEL(gpio0)));
		#if CONFIG_SM_GPIO_DEBUG
			gpio_pin_configure(gpio_dev, CONFIG_SM_PIN_APP, GPIO_OUTPUT_ACTIVE);
			sm_gpio_init(gpio_dev);
			PIN_SM_CLEAR;
			PIN_SM_SET;
			PIN_SM_CLEAR;
		#endif
	#endif
}


void main(void)
{
	app_gpio_init();
	#ifdef CONFIG_USB
		int ret;
		ret = usb_enable(NULL);
		if (ret != 0) {
			LOG_ERR("Failed to enable USB");
			return;
		}
		//TODO wait for USB to be connected
	#endif

	k_sleep(K_SECONDS(5));

	sm_start();
	std::string uid = sm_get_uid();
	printf("simplemesh_cli> listening from UID (%s)\n",uid.c_str());

	console_getline_init();
	while (1) {
		printf(">");fflush(NULL);
		char *text = console_getline();
	    uint8_t size = strlen(text);
		std::string payload(text,size);
		if(payload.find("{") != std::string::npos){
			mesh_bcast_packet(sm::pid::json,(uint8_t*)text,size);
		}else{
			mesh_bcast_packet(sm::pid::text,(uint8_t*)text,size);
		}
		if(critical_parse){
			sys_reboot(SYS_REBOOT_WARM);//param unused on ARM-M
		}
	}
}
```
