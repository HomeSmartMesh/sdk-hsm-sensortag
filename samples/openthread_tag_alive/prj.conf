## prj.conf
```kconfig
CONFIG_OPENTHREAD_NORDIC_LIBRARY_MASTER=y
CONFIG_NETWORKING=y
CONFIG_NET_L2_OPENTHREAD=y
CONFIG_NET_IPV6_NBR_CACHE=n
CONFIG_NET_IPV6_MLD=n
CONFIG_NET_SOCKETS=y
CONFIG_NET_SOCKETS_POLL_MAX=5
CONFIG_NET_SOCKETS_POSIX_NAMES=y
CONFIG_NET_CONNECTION_MANAGER=n
CONFIG_NET_IPV4=n
CONFIG_NET_IPV6=y
CONFIG_OPENTHREAD_NORDIC_LIBRARY_MTD=y
CONFIG_OPENTHREAD_MTD=y
CONFIG_OPENTHREAD_FTD=n
CONFIG_OPENTHREAD_MANUAL_START=n
CONFIG_MBEDTLS_SHA1_C=n
CONFIG_FPU=y
CONFIG_OPENTHREAD_CHANNEL=24
CONFIG_OPENTHREAD_PANID=4660
CONFIG_OPENTHREAD_NETWORK_NAME="ThreadMatter"
CONFIG_OPENTHREAD_XPANID="11:11:11:11:22:22:22:22"
CONFIG_OPENTHREAD_NETWORKKEY="00:11:22:33:44:55:66:77:88:99:aa:bb:cc:dd:ee:ff"

##########################
#CONFIG_SPEED_OPTIMIZATIONS=y
#CONFIG_MAIN_STACK_SIZE=2048
#CONFIG_INIT_STACKS=y
#CONFIG_ENTROPY_GENERATOR=y
#CONFIG_PRINTK=n
#CONFIG_SYSTEM_WORKQUEUE_STACK_SIZE=2048
#CONFIG_GPIO=y
#CONFIG_PM=y
#CONFIG_PM_DEVICE=y
#CONFIG_SERIAL=n
#CONFIG_LOG=n
#CONFIG_CONSOLE=n
#CONFIG_UART_CONSOLE=n
#CONFIG_RTT_CONSOLE=n
#CONFIG_USE_SEGGER_RTT=n
#CONFIG_NEWLIB_LIBC=y
#CONFIG_NEWLIB_LIBC_FLOAT_PRINTF=y
#CONFIG_OPENTHREAD_MTD_SED=y
#CONFIG_OPENTHREAD_SLAAC=y
#CONFIG_OPENTHREAD_THREAD_VERSION_1_2=y
#CONFIG_OPENTHREAD_SHELL=n
#CONFIG_OPENTHREAD_POLL_PERIOD=600000
#CONFIG_OPENTHREAD_MANUAL_START=n
#CONFIG_OPENTHREAD_CHANNEL=24
#CONFIG_OPENTHREAD_PANID=4660
#CONFIG_OPENTHREAD_NETWORK_NAME="ThreadMatter"
#CONFIG_OPENTHREAD_XPANID="11:11:11:11:22:22:22:22"
#CONFIG_OPENTHREAD_NETWORKKEY="00:11:22:33:44:55:66:77:88:99:aa:bb:cc:dd:ee:ff"
#CONFIG_NET_IPV6_NBR_CACHE=n
#CONFIG_NET_IPV6_MLD=n
#CONFIG_NET_UDP=y
#CONFIG_NET_TCP=n
#CONFIG_NET_SOCKETS=y
#CONFIG_NET_SOCKETS_POSIX_NAMES=y
#CONFIG_NET_SOCKETS_POLL_MAX=4
#CONFIG_NET_CONNECTION_MANAGER=n
#CONFIG_NET_IPV4=n
#CONFIG_NET_IPV6=y
#CONFIG_NET_BUF_DATA_SIZE=256
#CONFIG_NET_BUF_RX_COUNT=80
#CONFIG_NET_BUF_TX_COUNT=80
#CONFIG_NET_CONTEXT_NET_PKT_POOL=y
#CONFIG_NET_PKT_RX_COUNT=16
#CONFIG_NET_PKT_TX_COUNT=16
#CONFIG_NET_CONFIG_NEED_IPV6=y
#CONFIG_NET_IF_UNICAST_IPV6_ADDR_COUNT=3
#CONFIG_NET_IF_MCAST_IPV6_ADDR_COUNT=4
#CONFIG_NET_MAX_CONTEXTS=10
```

## overlay-debug.conf
```kconfig
CONFIG_LOG=y
CONFIG_LOG_BACKEND_RTT=y
CONFIG_LOG_BACKEND_UART=n
CONFIG_BOOT_BANNER=y
CONFIG_USE_SEGGER_RTT=y

CONFIG_CONSOLE=y
CONFIG_UART_CONSOLE=n
CONFIG_RTT_CONSOLE=y

# shell
CONFIG_SHELL=n

# Network shell
CONFIG_NET_SHELL=n
CONFIG_OPENTHREAD_SHELL=n

# Logging
CONFIG_NET_LOG=y
CONFIG_LOG=y
CONFIG_NET_STATISTICS=y
CONFIG_PRINTK=y
```

## prj-joiner.conf
```kconfig
# Compiler
CONFIG_SPEED_OPTIMIZATIONS=y

# Kernel options
CONFIG_MAIN_STACK_SIZE=2048
CONFIG_INIT_STACKS=y
CONFIG_ENTROPY_GENERATOR=y
CONFIG_PRINTK=n
CONFIG_SYSTEM_WORKQUEUE_STACK_SIZE=2048

# Peripherals
CONFIG_GPIO=y

# Power optimization
CONFIG_PM=y
CONFIG_PM_DEVICE=y
CONFIG_SERIAL=n
CONFIG_LOG=n
CONFIG_CONSOLE=n
CONFIG_UART_CONSOLE=n
CONFIG_RTT_CONSOLE=n
CONFIG_USE_SEGGER_RTT=n

# message generation
CONFIG_NEWLIB_LIBC=y
CONFIG_NEWLIB_LIBC_FLOAT_PRINTF=y

# Network
CONFIG_NETWORKING=y
CONFIG_NET_L2_OPENTHREAD=y

# OpenThread options
CONFIG_NET_IPV6_MLD=n
CONFIG_OPENTHREAD_JOINER=y
CONFIG_OPENTHREAD_JOINER_AUTOSTART=y
CONFIG_OPENTHREAD_JOINER_PSKD="ABCDEF"
# Minimal Thread Device & Sleepy End Device
CONFIG_OPENTHREAD_MTD=y
CONFIG_OPENTHREAD_MTD_SED=y
#CONFIG_OPENTHREAD_FTD=y
CONFIG_OPENTHREAD_SLAAC=y
CONFIG_OPENTHREAD_THREAD_VERSION_1_2=y
CONFIG_OPENTHREAD_SHELL=n
CONFIG_OPENTHREAD_POLL_PERIOD=600000
CONFIG_OPENTHREAD_MANUAL_START=n
#CONFIG_OPENTHREAD_CHANNEL=13
#CONFIG_OPENTHREAD_PANID=4660
#CONFIG_OPENTHREAD_NETWORK_NAME="OpenThreadDemo"
#CONFIG_OPENTHREAD_XPANID="11:11:11:11:22:22:22:22"
#CONFIG_OPENTHREAD_MASTERKEY="00:11:22:33:44:55:66:77:88:99:aa:bb:cc:dd:ee:ff"

#CONFIG_NET_CONFIG_MY_IPV6_ADDR="fdde:ad00:beef::1"
#CONFIG_NET_CONFIG_PEER_IPV6_ADDR="ff02::1"
#CONFIG_PEER_PORT=4141

# Disable certain parts of Zephyr IPv6 stack
CONFIG_NET_IPV6_NBR_CACHE=n
CONFIG_NET_IPV6_MLD=n

# Generic networking options
CONFIG_NET_UDP=y
CONFIG_NET_TCP=n
CONFIG_NET_SOCKETS=y
CONFIG_NET_SOCKETS_POSIX_NAMES=y
CONFIG_NET_SOCKETS_POLL_MAX=4
CONFIG_NET_CONNECTION_MANAGER=n
CONFIG_NET_IPV4=n
CONFIG_NET_IPV6=y

# Network buffers
CONFIG_NET_BUF_DATA_SIZE=256
CONFIG_NET_BUF_RX_COUNT=80
CONFIG_NET_BUF_TX_COUNT=80
CONFIG_NET_CONTEXT_NET_PKT_POOL=y
CONFIG_NET_PKT_RX_COUNT=16
CONFIG_NET_PKT_TX_COUNT=16

# IP address options
CONFIG_NET_CONFIG_NEED_IPV6=y
CONFIG_NET_IF_UNICAST_IPV6_ADDR_COUNT=3
CONFIG_NET_IF_MCAST_IPV6_ADDR_COUNT=4
CONFIG_NET_MAX_CONTEXTS=10
```

## src/main.c
```c
#include <zephyr.h>
#include <logging/log.h>
#include <net/socket.h>
#include <net/net_if.h>
#include <stdio.h>
#include <drivers/gpio.h>

#include <net/openthread.h>
#include <openthread/thread.h>

#include "hal/nrf_radio.h"

#include "udp_client.h"

LOG_MODULE_REGISTER(main, LOG_LEVEL_DBG);
#define SLEEP_TIME_MS   10000

#define DEBUG_PIN_APP 	 2
#define DEBUG_PIN_OS	29

#define APP_SET 	gpio_pin_set(gpio_dev, DEBUG_PIN_APP, 1)	
#define APP_CLEAR 	gpio_pin_set(gpio_dev, DEBUG_PIN_APP, 0)
#define LOOP_SET 	gpio_pin_set(gpio_dev, DEBUG_PIN_OS, 1)
#define LOOP_CLEAR 	gpio_pin_set(gpio_dev, DEBUG_PIN_OS, 0)

const struct device *gpio_dev;
void gpio_pin_init()
{
	gpio_dev = device_get_binding(DT_LABEL(DT_NODELABEL(gpio0)));
	int ret = gpio_pin_configure(gpio_dev, DEBUG_PIN_APP, GPIO_OUTPUT_ACTIVE);
	if (ret < 0) {
		LOG_ERR("gpio_pin_configure() failed");
	}
	ret = gpio_pin_configure(gpio_dev, DEBUG_PIN_OS, GPIO_OUTPUT_ACTIVE);
	if (ret < 0) {
		LOG_ERR("gpio_pin_configure() failed");
	}
}

void print_ot_info(otInstance *instance)
{
	otDeviceRole role = otThreadGetDeviceRole(instance);
        switch (role)
        {
        case OT_DEVICE_ROLE_DISABLED:
            LOG_INF("state : disabled");
            break;
        case OT_DEVICE_ROLE_DETACHED:
            LOG_INF("state : detached");
            break;
        case OT_DEVICE_ROLE_CHILD:
            LOG_INF("state : child");
            break;
        case OT_DEVICE_ROLE_ROUTER:
            LOG_INF("state : router");
            break;
        case OT_DEVICE_ROLE_LEADER:
            LOG_INF("state : leader");
            break;
        default:
            LOG_INF("state : invalid");
            break;
        }

	otLinkModeConfig linkMode = otThreadGetLinkMode(instance);
	LOG_INF(" * Rx On WhenIdle: %d , * Full Thread Device %d, * Full Network Data %d",
						linkMode.mRxOnWhenIdle,linkMode.mDeviceType,linkMode.mNetworkData);
}

void main(void)
{
	gpio_pin_init();
	APP_CLEAR;
	LOOP_CLEAR;
	k_sleep(K_MSEC(10));

	APP_SET;
	k_sleep(K_MSEC(10));
	APP_CLEAR;

	LOG_INF("Hello openthread udp");
	k_sleep(K_MSEC(10));

	otInstance *openthread = openthread_get_default_instance();
    bool rxOnWhenIdle = false;
    bool deviceType = false;//Not FTD just MTD
    bool networkData = false;//No full Network Data
	otLinkModeConfig linkMode = {rxOnWhenIdle, deviceType, networkData};
	otThreadSetLinkMode(openthread,linkMode);

	long unsigned int id0 = NRF_FICR->DEVICEID[0];//just for type casting and readable printing
	long unsigned int id1 = NRF_FICR->DEVICEID[1];
	int count = 0;
	while (1) {
		LOOP_SET;
		LOG_INF("starting loop (%d)",count);
		print_ot_info(openthread);
		
		char message[250];
		int size = sprintf(message,"thread_tags/%04lX%04lX{\"alive\":%d}",id0,id1,count);

		APP_SET;
		send_udp(message, size);
		APP_CLEAR;
		k_sleep(K_MSEC(100));

		printf("%s\n",message);
		LOG_INF("sleeping 1 sec");
		count++;
		LOOP_CLEAR;
		k_sleep(K_MSEC(3000));

	}
}
```
