## prj.conf
```kconfig
CONFIG_GPIO=y
CONFIG_SERIAL=y

# Power optimization
CONFIG_PM=y
CONFIG_PM_DEVICE=y
CONFIG_SERIAL=n
CONFIG_LOG=n
CONFIG_CONSOLE=n
CONFIG_UART_CONSOLE=n
CONFIG_RTT_CONSOLE=n
CONFIG_USE_SEGGER_RTT=n
CONFIG_PRINTK=n

# message generation
CONFIG_NEWLIB_LIBC=y
CONFIG_NEWLIB_LIBC_FLOAT_PRINTF=y

# RF Mesh
CONFIG_ESB=y
CONFIG_SIMPLEMESH=y
CONFIG_SM_CHANNEL=20
CONFIG_SM_LISTENER=n

#C++
CONFIG_CPLUSPLUS=y
CONFIG_LIB_CPLUSPLUS=y
CONFIG_STD_CPP11=n
CONFIG_STD_CPP17=y
```

## src/main.cpp
```c
#include <zephyr.h>
#include <logging/log.h>
#include <stdio.h>
#include <usb/usb_device.h>

#include <json.hpp>
#include <simplemesh.h>

LOG_MODULE_REGISTER(main, LOG_LEVEL_DBG);
json j;

void main(void)
{
	LOG_INF("Hello Simple Mesh from Sensor Tag");

	sm_start();

	int loop = 0;
	while (1) {
		j["alive"] = loop;
		mesh_bcast_json(j);
		printk("broadcasted : %s\n",j.dump().c_str());
		k_sleep(K_SECONDS(4));
		loop++;
	}
}
```
