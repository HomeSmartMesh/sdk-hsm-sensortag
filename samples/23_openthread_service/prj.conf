## CMakeLists.txt
```
set(BOARD_ROOT ${CMAKE_CURRENT_SOURCE_DIR}/../..)

cmake_minimum_required(VERSION 3.13.1)
set(BOARD nrf52840_sensortag)
find_package(Zephyr REQUIRED HINTS $ENV{ZEPHYR_BASE})
project(openthread_sensor_service)

target_sources(app PRIVATE src/main.c)
```

## prj.conf
```kconfig
CONFIG_I2C=y
CONFIG_SENSOR=y
CONFIG_VEML6030=y
CONFIG_MS8607=y

CONFIG_ADC=y
CONFIG_BATTERY=y
CONFIG_APP_OT=y
CONFIG_APP_FLASH=y
CONFIG_APP_LED=y


CONFIG_GPIO=y
CONFIG_PWM=y
CONFIG_PINCTRL=y

CONFIG_OPENTHREAD_SRP_CLIENT=y

CONFIG_OPENTHREAD_NORDIC_LIBRARY_MASTER=y
CONFIG_NETWORKING=y
CONFIG_NET_L2_OPENTHREAD=y
CONFIG_NET_IPV6_NBR_CACHE=n
CONFIG_NET_IPV6_MLD=n
CONFIG_NET_SOCKETS=y
CONFIG_NET_SOCKETS_POLL_MAX=5
CONFIG_NET_SOCKETS_POSIX_NAMES=y
CONFIG_NET_CONNECTION_MANAGER=n
CONFIG_NET_IPV4=n
CONFIG_NET_IPV6=y
CONFIG_OPENTHREAD_FTD=y
CONFIG_OPENTHREAD_NORDIC_LIBRARY_MTD=y
CONFIG_OPENTHREAD_MTD=y
CONFIG_OPENTHREAD_MTD_SED=y
CONFIG_OPENTHREAD_POLL_PERIOD=1000
CONFIG_OPENTHREAD_MANUAL_START=n
CONFIG_MBEDTLS_SHA1_C=n
CONFIG_FPU=y

CONFIG_NEWLIB_LIBC=y
CONFIG_NEWLIB_LIBC_FLOAT_PRINTF=y

#prevents Stack overflow on k_work_
CONFIG_SYSTEM_WORKQUEUE_STACK_SIZE=4096
CONFIG_MAIN_STACK_SIZE=8192

#Low power config
CONFIG_PM=y
CONFIG_PM_DEVICE=y
CONFIG_SERIAL=n
CONFIG_LOG=n
CONFIG_CONSOLE=n
CONFIG_UART_CONSOLE=n
CONFIG_RTT_CONSOLE=n
CONFIG_USE_SEGGER_RTT=n
CONFIG_PRINTK=n
CONFIG_NETWORKING=y
CONFIG_OPENTHREAD_SHELL=n
########################################
#CONFIG_INIT_STACKS=y
#CONFIG_NET_UDP=y
#CONFIG_NET_TCP=n
#CONFIG_NET_CONNECTION_MANAGER=y
#CONFIG_NET_PKT_RX_COUNT=1
#CONFIG_NET_PKT_TX_COUNT=4
#CONFIG_NET_BUF_RX_COUNT=2
#CONFIG_NET_BUF_TX_COUNT=8
#CONFIG_NET_CONTEXT_NET_PKT_POOL=y
#CONFIG_NET_IF_UNICAST_IPV6_ADDR_COUNT=3
#CONFIG_NET_IF_MCAST_IPV6_ADDR_COUNT=4
#CONFIG_NET_MAX_CONTEXTS=2
```

## overlay-ot-fixed.conf
```kconfig
CONFIG_OPENTHREAD_NETWORK_NAME="ot_zephyr"
CONFIG_OPENTHREAD_CHANNEL=11
CONFIG_OPENTHREAD_PANID=43981
CONFIG_OPENTHREAD_XPANID="de:ad:00:be:ef:00:ca:fe"
CONFIG_OPENTHREAD_NETWORKKEY="00:11:22:33:44:55:66:77:88:99:aa:bb:cc:dd:ee:ff"
```

## src/main.c
```c
#include <zephyr/kernel.h>
#include <zephyr/logging/log.h>
#include <zephyr/net/socket.h>
#include <zephyr/net/net_if.h>
#include <zephyr/net/openthread.h>
#include <zephyr/drivers/gpio.h>
#include <zephyr/drivers/sensor.h>
#include <zephyr/sys/printk.h>
#include <zephyr/sys/reboot.h>

#include <stdio.h>

#include <sensor/veml6030.h>
#include <sensor/ms8607.h>

#include <openthread/thread.h>
#include <openthread/coap.h>
#include <openthread/srp_client.h>

#include "battery.h"

LOG_MODULE_REGISTER(main, LOG_LEVEL_INF);

char device_id[20];

const struct device *light_dev = DEVICE_DT_GET_ONE(vishay_veml6030);

static otCoapResource battery_resource = {
    .mUriPath = "battery",
    .mHandler = NULL,
    .mContext = NULL,
    .mNext = NULL,
};

static otCoapResource veml6030_resource = {
    .mUriPath = "veml6030",
    .mHandler = NULL,
    .mContext = NULL,
    .mNext = NULL,
};

static otCoapResource ms8607_resource = {
    .mUriPath = "ms8607",
    .mHandler = NULL,
    .mContext = NULL,
    .mNext = NULL,
};

static otSrpClientService sensortag_service = {
    .mInstanceName = "",
    .mName = "_sensortag._udp",
    .mPort = 5683,
};

static void battery_handler(void *context, otMessage *message, const otMessageInfo *message_info)
{
    otMessage *responseMessage = otCoapNewMessage(context, NULL);

    battery_start();
    if (otCoapMessageGetCode(message) != OT_COAP_CODE_GET) {
        LOG_ERR("Battery handler - Unexpected CoAP code");
        otCoapMessageInitResponse(responseMessage,
                message,
                OT_COAP_TYPE_ACKNOWLEDGMENT,
                OT_COAP_CODE_METHOD_NOT_ALLOWED);
        otCoapSendResponse(context, responseMessage, message_info);
        return;
    }

    int32_t voltage_mv = battery_get_mv();
    float voltage = voltage_mv/1000.0;
    char content[100];
    int n = sprintf(content,"{\"device_id\":\"%s\", \"voltage\":%.3f}", device_id, voltage);

    // send response message
    otCoapMessageInitResponse(
            responseMessage,
            message,
            otCoapMessageGetType(message) == OT_COAP_TYPE_CONFIRMABLE
                ? OT_COAP_TYPE_ACKNOWLEDGMENT
                : OT_COAP_TYPE_NON_CONFIRMABLE,
            OT_COAP_CODE_CONTENT);
    otCoapMessageAppendContentFormatOption(responseMessage, OT_COAP_OPTION_CONTENT_FORMAT_JSON);
    otCoapMessageSetPayloadMarker(responseMessage);
    otMessageAppend(responseMessage, content, n);

    otCoapSendResponse(context, responseMessage, message_info);
}

static void veml6030_handler(void *context, otMessage *message, const otMessageInfo *message_info)
{
    otMessage *responseMessage = otCoapNewMessage(context, NULL);

    if (otCoapMessageGetCode(message) != OT_COAP_CODE_GET) {
        LOG_ERR("Battery handler - Unexpected CoAP code");
        otCoapMessageInitResponse(responseMessage,
                message,
                OT_COAP_TYPE_ACKNOWLEDGMENT,
                OT_COAP_CODE_METHOD_NOT_ALLOWED);
        otCoapSendResponse(context, responseMessage, message_info);
        return;
    }

    float light = veml6030_auto_measure(light_dev);
    char content[100];
    int n = sprintf(content,"{\"device_id\":\"%s\", \"light\":%.3f}", device_id, light);

    // send response message
    otCoapMessageInitResponse(
            responseMessage,
            message,
            otCoapMessageGetType(message) == OT_COAP_TYPE_CONFIRMABLE
                ? OT_COAP_TYPE_ACKNOWLEDGMENT
                : OT_COAP_TYPE_NON_CONFIRMABLE,
            OT_COAP_CODE_CONTENT);
    otCoapMessageAppendContentFormatOption(responseMessage, OT_COAP_OPTION_CONTENT_FORMAT_JSON);
    otCoapMessageSetPayloadMarker(responseMessage);
    otMessageAppend(responseMessage, content, n);

    otCoapSendResponse(context, responseMessage, message_info);
}

static void ms8607_handler(void *context, otMessage *message, const otMessageInfo *message_info)
{
    otMessage *responseMessage = otCoapNewMessage(context, NULL);

    if (otCoapMessageGetCode(message) != OT_COAP_CODE_GET) {
        LOG_ERR("Battery handler - Unexpected CoAP code");
        otCoapMessageInitResponse(responseMessage,
                message,
                OT_COAP_TYPE_ACKNOWLEDGMENT,
                OT_COAP_CODE_METHOD_NOT_ALLOWED);
        otCoapSendResponse(context, responseMessage, message_info);
        return;
    }

    float t, p, h;
    enum ms8607_status status = ms8607_read_temperature_pressure_humidity(&t, &p, &h);
    char content[100];
    int n = sprintf(content,"{\"device_id\":\"%s\", \"temperature\":%.2f, \"pressure\":%.2f, \"humidity\":%.2f}", device_id, t, p, h);

    // send response message
    otCoapMessageInitResponse(
            responseMessage,
            message,
            otCoapMessageGetType(message) == OT_COAP_TYPE_CONFIRMABLE
                ? OT_COAP_TYPE_ACKNOWLEDGMENT
                : OT_COAP_TYPE_NON_CONFIRMABLE,
            OT_COAP_CODE_CONTENT);
    otCoapMessageAppendContentFormatOption(responseMessage, OT_COAP_OPTION_CONTENT_FORMAT_JSON);
    otCoapMessageSetPayloadMarker(responseMessage);
    otMessageAppend(responseMessage, content, n);

    otCoapSendResponse(context, responseMessage, message_info);
}

int coap_init(otInstance *instance)
{
    battery_resource.mContext = instance;
    battery_resource.mHandler = battery_handler;
    otCoapAddResource(instance, &battery_resource);

    veml6030_resource.mContext = instance;
    veml6030_resource.mHandler = veml6030_handler;
    otCoapAddResource(instance, &veml6030_resource);

    ms8607_resource.mContext = instance;
    ms8607_resource.mHandler = ms8607_handler;
    otCoapAddResource(instance, &ms8607_resource);

    otCoapStart(instance, OT_DEFAULT_COAP_PORT);
}

void main(void)
{
    int ret;

    otInstance* instance = openthread_get_default_instance();

    battery_init();
    ms8607_is_connected();

    coap_init(instance);

    long unsigned int id0 = NRF_FICR->DEVICEID[0];
    long unsigned int id1 = NRF_FICR->DEVICEID[1];
    sprintf(device_id, "%04lX%04lX", id0, id1);
    LOG_INF("Device ID: %s", device_id);

    sensortag_service.mInstanceName = device_id;
    ret = otSrpClientAddService(instance, &sensortag_service);

    ret = otSrpClientSetHostName(instance, device_id);
    ret = otSrpClientEnableAutoHostAddress(instance);
    otSrpClientEnableAutoStartMode(instance, NULL, NULL);
}
```
